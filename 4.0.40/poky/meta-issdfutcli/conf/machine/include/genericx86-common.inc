## 4.0.40/poky/meta-issdfutcli/conf/machine/include/genericx86-common.inc
```bitbake
include conf/machine/include/x86/x86-base.inc
MACHINE_FEATURES += "efi pcbios"

PREFERRED_VERSION_linux-yocto = "5.18%"
PREFERRED_PROVIDER_virtual/kernel ?= "linux-yocto"
PREFERRED_PROVIDER_virtual/xserver ?= "xserver-xorg"
XSERVER ?= "${XSERVER_X86_BASE} \
            ${XSERVER_X86_EXT} \
            ${XSERVER_X86_I915} \
            ${XSERVER_X86_I965} \
            ${XSERVER_X86_FBDEV} \
            ${XSERVER_X86_VESA} \
            ${XSERVER_X86_MODESETTING} \
           "

MACHINE_EXTRA_RRECOMMENDS += "linux-firmware v86d eee-acpi-scripts"

GLIBC_ADDONS = "nptl"

EXTRA_OECONF:append:pn-matchbox-panel-2 = " --with-battery=acpi"
```

## 4.1.17/poky/build/conf/bblayers.conf
```bitbake
# POKY_BBLAYERS_CONF_VERSION is increased each time build/conf/bblayers.conf
# changes incompatibly
POKY_BBLAYERS_CONF_VERSION = "2"

BBPATH = "${TOPDIR}"
BBFILES ?= ""

BBLAYERS ?= " \
  /qb/workspace/15440/CustomerTools/FirmwareUpdateTool/poky/meta \
  /qb/workspace/15440/CustomerTools/FirmwareUpdateTool/poky/meta-poky \
  /qb/workspace/15440/CustomerTools/FirmwareUpdateTool/poky/meta-yocto-bsp \
  /qb/workspace/15440/CustomerTools/FirmwareUpdateTool/poky/meta-issdfutcli \
  "
```

## 4.1.17/poky/meta-issdfutcli/conf/layer.conf
```bitbake
# We have a conf and classes directory, add to BBPATH
BBPATH =. "${LAYERDIR}:"

# We have recipes-* directories, add to BBFILES
BBFILES += "${LAYERDIR}/recipes-*/*/*.bb \
            ${LAYERDIR}/recipes-*/*/*.bbappend"

BBFILE_COLLECTIONS += "issdfutcli"
BBFILE_PATTERN_issdfutcli = "^${LAYERDIR}/"
BBFILE_PRIORITY_issdfutcli = "6"

LAYERSERIES_COMPAT_issdfutcli = "kirkstone langdale"

# This should only be incremented on significant changes that will
# cause compatibility issues with other layers
LAYERVERSION_issdfutcli = "2"

LICENSE_PATH += "${LAYERDIR}/licenses"
```

## 4.1.17/poky/meta-issdfutcli/conf/machine/genericx86-64.conf
```bitbake
#@TYPE: Machine
#@NAME: Generic X86_64.

#@DESCRIPTION: Machine configuration for generic X86_64 (64-bit) PCs and servers. Supports a moderately wide range of drivers that should boot and be usable on "typical" hardware.

DEFAULTTUNE ?= "corei7-64"
require conf/machine/include/x86/tune-corei7.inc
require conf/machine/include/genericx86-common.inc

MACHINE_ESSENTIAL_EXTRA_RRECOMMENDS += "gma500-gfx-check"

PREFERRED_VERSION_linux-yocto:genericx86-64 ?= "6.0%"

#SERIAL_CONSOLES_CHECK = "ttyS0"
```
